## config/boards/shields/custom_view/Kconfig.defconfig
```kconfig
# config/boards/shields/custom_view/Kconfig.defconfig

# LVGL/Display Defaults passend zum 160x68 Memory-LCD
config LV_Z_VDB_SIZE
    default 100
config LV_DPI_DEF
    default 161
config LV_Z_BITS_PER_PIXEL
    default 1
choice LV_COLOR_DEPTH
    default LV_COLOR_DEPTH_1
endchoice

choice ZMK_DISPLAY_WORK_QUEUE
    default ZMK_DISPLAY_WORK_QUEUE_DEDICATED
endchoice

choice ZMK_DISPLAY_STATUS_SCREEN
    default ZMK_DISPLAY_STATUS_SCREEN_CUSTOM
endchoice

config LV_Z_MEM_POOL_SIZE
    default 4096 if ZMK_DISPLAY_STATUS_SCREEN_CUSTOM

# Unser Custom-Screen → impliziert das Widget (ohne SHIELD-Abhängigkeit)
config ZMK_DISPLAY_STATUS_SCREEN_CUSTOM
    imply CUSTOM_VIEW_WIDGET_STATUS

# Fonts & WPM-Unterstützung bequem zusammen mit dem Widget aktivieren
config CUSTOM_VIEW_WIDGET_STATUS
    select LV_FONT_MONTSERRAT_18
    select LV_FONT_MONTSERRAT_14
    select LV_FONT_UNSCII_8
    select ZMK_WPM

# Falls der Built-in-Screen gewählt wird, größere Font sicherstellen
config ZMK_DISPLAY_STATUS_SCREEN_BUILT_IN
    select LV_FONT_MONTSERRAT_26
```

## config/boards/shields/custom_view/Kconfig.shield
```kconfig
# config/boards/shields/custom_view/Kconfig.shield

menu "Custom View (status screen)"

config CUSTOM_VIEW_WIDGET_STATUS
    bool "Enable custom view status widget"
    default y
    select LV_USE_IMG
    select LV_USE_CANVAS
    select LV_FONT_MONTSERRAT_16

config CUSTOM_VIEW_SHOW_BATTERY
    bool "Show battery"
    default y

config CUSTOM_VIEW_SHOW_OUTPUT
    bool "Show USB/BLE icon"
    default y

config CUSTOM_VIEW_SHOW_PROFILES
    bool "Show BLE profiles"
    default y

config CUSTOM_VIEW_SHOW_LAYER
    bool "Show layer label"
    default y

config CUSTOM_VIEW_SHOW_WPM
    bool "Show WPM number"
    default y

config CUSTOM_VIEW_SHOW_WPM_SPARKLINE
    bool "Show WPM sparkline"
    depends on CUSTOM_VIEW_SHOW_WPM
    default y

config CUSTOM_VIEW_ROTATE_CANVAS
    bool "Rotate 68x68 canvases (legacy portrait)"
    default n

endmenu
```
